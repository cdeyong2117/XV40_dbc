VERSION ""

NS_ :

BS_:

BU_: XXX

BO_ 944 AMB_AIR_T: 6 XXX
 SG_ OUT_AIR_T : 24|8@1+ (1,-48) [8|98] "°C" XXX

BO_ 948 PRNDL_STATUS: 8 XXX
 SG_ DRIVE_IND : 46|1@1+ (1,0) [0|1] "" XXX

VAL_ 948 DRIVE_IND 0 "Off" 1 "On";

CM_ SG_ 944 OUT_AIR_T "Outside air temperature value displayed on the combination meter. Sent once/second. Data is in °C, converted to °F and rounded to the nearest whole number by the combination meter on USDM cars.";
CM_ SG_ 948 PRNDL_STATUS "PRNDL lights displayed on the combination meter."
